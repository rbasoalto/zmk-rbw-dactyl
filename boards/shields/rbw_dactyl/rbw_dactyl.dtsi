#include "rbw_dactyl-layouts.dtsi"

/ {
    chosen {
        zmk,kscan = &kscan0;
        // for studio support, the keyboard must not have a chosen zmk,matix_transform
        // zmk,matrix_transform = &default_transform;
        zmk,physical-layout = &rbw_dactyl_physycal_layout;
    };

    kscan0: kscan {
        compatible = "zmk,kscan-gpio-matrix";
        diode-direction = "col2row";
        wakeup-source;

        row-gpios
            = <&pro_micro 2 (GPIO_ACTIVE_HIGH | GPIO_PULL_DOWN)>
            , <&pro_micro 3 (GPIO_ACTIVE_HIGH | GPIO_PULL_DOWN)>
            , <&pro_micro 4 (GPIO_ACTIVE_HIGH | GPIO_PULL_DOWN)>
            , <&pro_micro 5 (GPIO_ACTIVE_HIGH | GPIO_PULL_DOWN)>
            , <&pro_micro 6 (GPIO_ACTIVE_HIGH | GPIO_PULL_DOWN)>
            ;

    };
};
