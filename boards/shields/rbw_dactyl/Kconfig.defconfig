## boards/shields/rbw_dactyl/Kconfig.defconfig
```kconfig
if SHIELD_RBW_DACTYL_LEFT

config ZMK_KEYBOARD_NAME
    default "RBW Dactyl"

config ZMK_SPLIT_ROLE_CENTRAL
    default y

endif

if SHIELD_RBW_DACTYL_LEFT || SHIELD_RBW_DACTYL_RIGHT

config ZMK_SPLIT
    default y

endif
```

## boards/shields/rbw_dactyl/Kconfig.shield
```kconfig
config SHIELD_RBW_DACTYL_LEFT
    def_bool $(shields_list_contains,rbw_dactyl_left)

config SHIELD_RBW_DACTYL_RIGHT
    def_bool $(shields_list_contains,rbw_dactyl_right)
```
